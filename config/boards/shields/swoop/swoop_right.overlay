/*
 * Copyright (c) 2022 Duccio Breschi
 *
 * SPDX-License-Identifier: MIT
 */

#include "swoop.dtsi"

&default_transform {
    col-offset = <5>;
};

&kscan0 {
    diode-direction = "col2row";
    col-gpios
        = <&pro_micro 21 (GPIO_ACTIVE_HIGH)> // COL0
        , <&pro_micro 20 (GPIO_ACTIVE_HIGH)> // COL1
        , <&pro_micro 19 (GPIO_ACTIVE_HIGH)> // COL2
        , <&pro_micro 18 (GPIO_ACTIVE_HIGH)> // COL3
        , <&pro_micro 15 (GPIO_ACTIVE_HIGH)> // COL4
    ;
    row-gpios
        = <&pro_micro 4 (GPIO_ACTIVE_HIGH | GPIO_PULL_DOWN)> // ROW0
        , <&pro_micro 5 (GPIO_ACTIVE_HIGH | GPIO_PULL_DOWN)> // ROW1
        , <&pro_micro 6 (GPIO_ACTIVE_HIGH | GPIO_PULL_DOWN)> // ROW2
        , <&pro_micro 7 (GPIO_ACTIVE_HIGH | GPIO_PULL_DOWN)> // ROW3
    ;
};
