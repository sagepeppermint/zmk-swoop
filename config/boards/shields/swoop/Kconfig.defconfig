## config/boards/shields/swoop/Kconfig.defconfig
```kconfig
if SHIELD_SWOOP_LEFT

config ZMK_KEYBOARD_NAME
    default "shah swoop"

config ZMK_SPLIT_ROLE_CENTRAL
    default y

endif

if SHIELD_SWOOP_LEFT || SHIELD_SWOOP_RIGHT
config ZMK_SPLIT
    default y
endif
```

## config/west.yml
```yaml
# manifest:
#   remotes:
#       # zmk official
#     - name: zmkfirmware
#       url-base: https://github.com/zmkfirmware
#       # bravekarma
# #    - name: caksoylar
# #      url-base: https://github.com/caksoylar
#   projects:
#     - name: zmk
#       remote: zmkfirmware
#       revision: main
#       import: app/west.yml
#   self:
#     path: config

manifest:
  remotes:
    - name: urob
      url-base: https://github.com/urob
  projects:
    - name: zmk
      remote: urob
      revision: main
      import: app/west.yml
  self:
    path: config
```
